## boards/arm/eh_iot_eval_2/Kconfig.board
```kconfig
# Copyright (c) 2024 Nordic Semiconductor ASA
# SPDX-License-Identifier: Apache-2.0

config BOARD_EH_IOT_EVAL_2
	bool "EH_IoT_Eval_2"
	depends on SOC_NRF52832_QFAA
```

## boards/arm/eh_iot_eval_2/Kconfig.defconfig
```kconfig
# Copyright (c) 2024 Nordic Semiconductor ASA
# SPDX-License-Identifier: Apache-2.0

if BOARD_EH_IOT_EVAL_2

config BOARD
	default "eh_iot_eval_2"

config BT_CTLR
   default BT


endif
```
